## firmware/esp32/boards/m5stack-sticks3/sdkconfig.defaults
```kconfig
# M5Stack M5StickS3
CONFIG_IDF_TARGET="esp32s3"

# 8 MB embedded flash
# CONFIG_ESPTOOLPY_FLASHSIZE_4MB is not set
CONFIG_ESPTOOLPY_FLASHSIZE_8MB=y

# 8 MB embedded PSRAM
CONFIG_SPIRAM=y
CONFIG_SPIRAM_MODE_OCT=y
CONFIG_SPIRAM_SPEED_80M=y
CONFIG_SPIRAM_USE_MALLOC=y
CONFIG_SPIRAM_IGNORE_NOTFOUND=y

CONFIG_ESP_DEFAULT_CPU_FREQ_MHZ_240=y

# Native USB Serial/JTAG
# CONFIG_ESP_CONSOLE_UART_DEFAULT is not set
CONFIG_ESP_CONSOLE_USB_SERIAL_JTAG=y

# StickS3 board
CONFIG_HG_BOARD_STICKS3=y
```
